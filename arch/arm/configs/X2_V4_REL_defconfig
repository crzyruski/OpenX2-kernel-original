## arch/arm/mach-pxa/imm/Kconfig
```kconfig
#
#  linux/arch/arm/mach-pxa/imm/Kconfig
#
#  Intel Memory Management
#
#  Module defines and configs
#
#  Todd Brandt
#  Copyright (c) 2004, Intel Corporation (todd.e.brandt@intel.com)
#
#  This program is free software; you can redistribute it and/or modify
#  it under the terms of the GNU General Public License version 2 as
#  published by the Free Software Foundation.
#

# (C) Copyright 2006 Marvell International Ltd.  
# All Rights Reserved 

menu "Marvell(R) Wireless Memory Management Technology"
depends on ARCH_PXA

config IMM
	bool "Marvell(R) Wireless Memory Management Support"
	depends on ARCH_PXA
	help
	  If you say Y here, the Intel Memory Management device will be
	  built into the kernel. IMM supplies specialized optimizations
	  for Intel XScale based processors.

config IMM_DEBUG
	bool "Debug Info"
	depends on IMM
	help
	  If you say Y here, IMM will print lots and lots of irritating
	  debug messages.

config IMM_API_SRAM
	bool "SRAM Allocation API"
	depends on IMM && PROFILING
	help
	  If you say Y here, IMM will provide an API to applications 
	  and drivers allowing them to allocate internal SRAM.

endmenu
```

## drivers/switch/Kconfig
```kconfig
menuconfig SWITCH
	tristate "Switch class support"
	help
	  Say Y here to enable switch class support. This allows
	  monitoring switches by userspace via sysfs and uevent.

if SWITCH

config SWITCH_GPIO
	tristate "GPIO Swith support"
	depends on GENERIC_GPIO
	help
	  Say Y here to enable GPIO based switch support.
	  
config ANDROID_HAEDSET
	tristate "Android headset driver for pxa"
	depends on PXA3xx_MICCO
	default n
	help
		Plesse say Y here if you want to add ANDROID headset

endif # SWITCH
```

## sound/soc/pxa/Kconfig
```kconfig
menu "SoC Audio for the Intel PXA2xx"

config SND_PXA2XX_SOC
	tristate "SoC Audio for the Intel PXA2xx chip"
	depends on ARCH_PXA
	select SND_PXA2XX_LIB
	help
	  Say Y or M if you want to add support for codecs attached to
	  the PXA2xx AC97, I2S or SSP interface. You will also need
	  to select the audio interfaces to support below.

config SND_PXA2XX_AC97
	tristate
	select SND_AC97_CODEC

config SND_PXA2XX_SOC_AC97
	tristate
	select AC97_BUS
	select SND_ARM
	select SND_PXA2XX_LIB_AC97
	select SND_SOC_AC97_BUS

config SND_PXA2XX_SOC_I2S
	tristate

config SND_PXA2XX_SOC_CORGI
	tristate "SoC Audio support for Sharp Zaurus SL-C7x0"
	depends on SND_PXA2XX_SOC && PXA_SHARP_C7xx
	select SND_PXA2XX_SOC_I2S
	select SND_SOC_WM8731
	help
	  Say Y if you want to add support for SoC audio on Sharp
	  Zaurus SL-C7x0 models (Corgi, Shepherd, Husky).

config SND_PXA2XX_SOC_SPITZ
	tristate "SoC Audio support for Sharp Zaurus SL-Cxx00"
	depends on SND_PXA2XX_SOC && PXA_SHARP_Cxx00
	select SND_PXA2XX_SOC_I2S
	select SND_SOC_WM8750
	help
	  Say Y if you want to add support for SoC audio on Sharp
	  Zaurus SL-Cxx00 models (Spitz, Borzoi and Akita).

config SND_PXA2XX_SOC_POODLE
	tristate "SoC Audio support for Poodle"
	depends on SND_PXA2XX_SOC && MACH_POODLE
	select SND_PXA2XX_SOC_I2S
	select SND_SOC_WM8731
	help
	  Say Y if you want to add support for SoC audio on Sharp
	  Zaurus SL-5600 model (Poodle).

config SND_PXA2XX_SOC_TOSA
	tristate "SoC AC97 Audio support for Tosa"
	depends on SND_PXA2XX_SOC && MACH_TOSA
	depends on MFD_TC6393XB
	select SND_PXA2XX_SOC_AC97
	select SND_SOC_WM9712
	help
	  Say Y if you want to add support for SoC audio on Sharp
	  Zaurus SL-C6000x models (Tosa).

config SND_PXA2XX_SOC_E800
	tristate "SoC AC97 Audio support for e800"
	depends on SND_PXA2XX_SOC && MACH_E800
	select SND_SOC_WM9712
	select SND_PXA2XX_SOC_AC97
	help
	  Say Y if you want to add support for SoC audio on the
	  Toshiba e800 PDA

config SND_PXA2XX_SOC_EM_X270
	tristate "SoC Audio support for CompuLab EM-x270"
	depends on SND_PXA2XX_SOC && MACH_EM_X270
	select SND_PXA2XX_SOC_AC97
	select SND_SOC_WM9712
	help
	  Say Y if you want to add support for SoC audio on
	  CompuLab EM-x270.
endmenu

menu "SoC Audio for the Intel PXA3xx"
config SND_PXA3XX_SOC
	bool "SoC Audio for the Intel PXA3xx chip"
	depends on ARCH_PXA && SND
	select SND_PCM
	help
	  Say Y or M if you want to add support for codecs attached to
	  the PXA3xx AC97, I2S or SSP interface. You will also need
	  to select the audio interfaces to support below.

config AC97_EXTCLK
	bool

config SND_PXA3XX_SOC_AC97
	tristate
	select AC97_EXTCLK
	select AC97_BUS
	select SND_SOC_AC97_BUS

config SND_PXA3XX_SOC_AC97CODEC_PM
	tristate
	select SND_PXA3XX_SOC_AC97

config SND_PXA3XX_SOC_SSP
	tristate

config SND_PXA3XX_SOC_ZYLONITE
	bool "SoC AC97 Audio support for Zylonite"
	depends on SND_PXA3XX_SOC && MACH_ZYLONITE
	select SND_PXA3XX_SOC_AC97
	select SND_PXA3XX_SOC_SSP
	select SND_SOC_WM9713
	select SND_PXA3XX_SOC_AC97CODEC_PM
	help
	  Say Y if you want to add support for SoC audio on Zylonite

config SND_PXA3XX_SOC_TAVOREVB
	bool "SoC Audio support for TavorEVB2"
	depends on SND_PXA3XX_SOC && MACH_TAVOREVB
	select SND_PXA3XX_SOC_SSP
	select SND_SOC_MICCO
	help
	  Say Y if you want to add support for SoC audio on Tavor EVB2 Platform

config SND_PXA3XX_SOC_LITTLETON
	bool "SoC Audio support for Littleton"
	depends on SND_PXA3XX_SOC && MACH_LITTLETON
	select SND_PXA3XX_SOC_SSP
	select SND_SOC_MICCO
	help
	  Say Y if you want to add support for SoC audio on Littleton

config SND_PXA3XX_SOC_SAAR
	bool "SoC Audio support for SAAR"
	depends on SND_PXA3XX_SOC && MACH_SAAR
	select SND_PXA3XX_SOC_SSP
	select SND_SOC_MICCO
	help
	  Say Y if you want to add support for SoC audio on SAAR

endmenu
```
